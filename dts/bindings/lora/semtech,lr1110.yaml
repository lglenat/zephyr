## dts/bindings/lora/semtech,lr1110.yaml
```yaml
description: Semtech LR1110 LoRa Modem

compatible: "semtech,lr1110"

include: spi-device.yaml

properties:
  busy-gpios:
    type: phandle-array
    required: true
    description: |
      GPIO connected to the modem's BUSY signal.

  reset-gpios:
    type: phandle-array
    required: false
    description: |
      GPIO connected to the modem's NRESET signal.

  dio1-gpios:
    type: phandle-array
    required: true
    description: |
      GPIO connected to DIO1. This GPIO will be used as a generic
      IRQ line from the chip.

  tcxo:
    type: boolean
    required: false
    description: |
      Set to true if there's a TCXO.
```
